## main/Kconfig.projbuild
```kconfig
menu "Light Controller Configuration"
    config INBOUND_WIFI_SSID
        string "Inbound WiFi SSID"
        default "Light Configuration"
        help
            WiFi SSID of the network that the light will expose for configuration
    
    config INBOUND_WIFI_PASSWORD
        string "Inbound WiFi Password"
        help
            WiFi Password for the network exposed by the light for configuration

    config OUTBOUND_WIFI_SSID
        string "Outbound WiFi SSID"
        default "Free Internet"
        help
            WiFi SSID of the network that the light will use to pull data from the internet

    config OUTBOUND_WIFI_PASSWORD
        string "Outbound WiFi Password"
        help
            WiFi Password for the network the light will use to pull data from the internet

    config SNTP_SERVER_HOSTNAME
        string "SNTP Server Hostname"
        default "time.nist.gov"
        help
            Hostname for the SNTP server

    config WIFI_MAX_RETRIES
        int "WiFi max retries"
        default 3
        help
            Maximum number of times the device will attempt to connect to WiFi
    
    config SNTP_MAX_RETRIES
        int "SNTP max retries"
        default 3
        help
            Maximum number of times the device will attempt to synchronize time over SNTP
endmenu
```
